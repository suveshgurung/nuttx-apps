## examples/uart_comm/Kconfig
```kconfig
config EXAMPLES_UART_COMM
  tristate "UART Communication Example"
  default n
  ---help---
    Enable the UART Coomunication example

if EXAMPLES_UART_COMM

config EXAMPLES_UART_COMM_PROGNAME
  string "Program name"
  default "uart_comm"

config EXAMPLES_UART_COMM_PRIORITY
  int "Task priority"
  default 100

config EXAMPLES_UART_COMM_STACKSIZE
  int "Stack size"
  default 2048

endif
```
